## prj.conf
```kconfig
# General config
CONFIG_NEWLIB_LIBC=y
CONFIG_ASSERT=y
CONFIG_REBOOT=y

# Network
CONFIG_NETWORKING=y
CONFIG_NET_NATIVE=n
CONFIG_NET_IPV6=n
CONFIG_NET_IPV4=y
CONFIG_NET_SOCKETS=y
CONFIG_NET_SOCKETS_OFFLOAD=y

# LwM2M
CONFIG_NRF91_LWM2M_APP=y
CONFIG_NRF91_LWM2M_APP_LOG_LEVEL_DBG=y
CONFIG_LWM2M=y
CONFIG_LWM2M_DNS_SUPPORT=y
CONFIG_LWM2M_RW_JSON_SUPPORT=n
CONFIG_LWM2M_SERVER_DEFAULT_PMIN=1
CONFIG_LWM2M_SERVER_DEFAULT_PMAX=300
CONFIG_LWM2M_IPSO_SUPPORT=y
CONFIG_LWM2M_IPSO_TEMP_SENSOR=y
CONFIG_LWM2M_IPSO_LIGHT_CONTROL=y
CONFIG_LWM2M_IPSO_BUZZER=y
CONFIG_LWM2M_IPSO_ONOFF_SWITCH=y
CONFIG_LWM2M_IPSO_ONOFF_SWITCH_INSTANCE_COUNT=2
CONFIG_LWM2M_IPSO_PUSH_BUTTON=y
CONFIG_LWM2M_IPSO_PUSH_BUTTON_INSTANCE_COUNT=2
CONFIG_LWM2M_IPSO_ACCELEROMETER=y
CONFIG_LWM2M_IPSO_TIMESTAMP_EXTENSIONS=y

# DTLS settings
CONFIG_LWM2M_DTLS_SUPPORT=y
CONFIG_LWM2M_PEER_PORT=5684

# nRF9160 helper libraries
CONFIG_MODEM_KEY_MGMT=y

# Default app to debug logging
CONFIG_LOG=y
CONFIG_APP_LOG_LEVEL_DBG=y

# Expand logging memory to avoid log_strdup() errors
CONFIG_LOG_STRDUP_MAX_STRING=64
CONFIG_LOG_STRDUP_BUF_COUNT=32

# Support HEX style PSK values (double the size + NULL char)
CONFIG_LWM2M_SECURITY_KEY_SIZE=33

# extend CoAP retry timing to 10 seconds for LTE/LTE-M
CONFIG_COAP_INIT_ACK_TIMEOUT_MS=10000

# Enable CoAP extended option length
CONFIG_COAP_EXTENDED_OPTIONS_LEN=y
CONFIG_COAP_EXTENDED_OPTIONS_LEN_VALUE=40

# UI settings
CONFIG_UI_BUTTON=y
CONFIG_UI_BUZZER=y

# Enable temp sensor
CONFIG_SENSOR=y
# TODO: No DIE temp sensor on nRF9150, select a temp sensor?
# CONFIG_TEMP_NRF5=y

# Enable settings storage
CONFIG_SETTINGS=y
CONFIG_FCB=y
CONFIG_SETTINGS_FCB=y

# LTE link control
CONFIG_LTE_LINK_CONTROL=y
CONFIG_LTE_AUTO_INIT_AND_CONNECT=n

# Modem library
CONFIG_NRF_MODEM_LIB=y

# Modem info
CONFIG_MODEM_INFO=y
CONFIG_MODEM_INFO_ADD_DATE_TIME=n

# Library for buttons and LEDs
CONFIG_DK_LIBRARY=y
CONFIG_DK_LIBRARY_INVERT_LEDS=n

# Enable shell
CONFIG_NET_SHELL=y

# Heap and stacks
CONFIG_HEAP_MEM_POOL_SIZE=16384
CONFIG_MAIN_STACK_SIZE=8192
CONFIG_SYSTEM_WORKQUEUE_STACK_SIZE=2048

# Temporarily disable CC310 entropy driver
CONFIG_ENTROPY_CC3XX=n
CONFIG_TEST_RANDOM_GENERATOR=y

# Set LwM2M Server IP address here
CONFIG_APP_LWM2M_SERVER=""
```

## src/main.c
```c
/*
 * Copyright (c) 2019 Nordic Semiconductor ASA
 *
 * SPDX-License-Identifier: LicenseRef-Nordic-5-Clause
 */

#include <zephyr.h>
#include <ctype.h>
#include <drivers/gpio.h>
#include <stdio.h>
#include <net/lwm2m.h>
#include <modem/nrf_modem_lib.h>
#include <settings/settings.h>

#include <net/lwm2m_client_utils.h>
#include <net/lwm2m_client_utils_fota.h>

#include <logging/log.h>
LOG_MODULE_REGISTER(app_lwm2m_client, CONFIG_APP_LOG_LEVEL);

#include <modem/at_cmd.h>
#include <modem/lte_lc.h>

#if defined(CONFIG_LWM2M_DTLS_SUPPORT)
#if defined(CONFIG_MODEM_KEY_MGMT)
#include <modem/modem_key_mgmt.h>
#endif
#endif

#include "ui.h"
#include "lwm2m_client_app.h"

#if !defined(CONFIG_LTE_LINK_CONTROL)
#error "Missing CONFIG_LTE_LINK_CONTROL"
#endif

BUILD_ASSERT(sizeof(CONFIG_APP_LWM2M_SERVER) > 1,
		 "CONFIG_APP_LWM2M_SERVER must be set in prj.conf");

#define APP_BANNER "Run LWM2M client"

#define IMEI_LEN		15
#define ENDPOINT_NAME_LEN	(IMEI_LEN + 8)

#define LWM2M_SECURITY_PRE_SHARED_KEY 0
#define LWM2M_SECURITY_RAW_PUBLIC_KEY 1
#define LWM2M_SECURITY_CERTIFICATE 2
#define LWM2M_SECURITY_NO_SEC 3

static uint8_t endpoint_name[ENDPOINT_NAME_LEN+1];
static uint8_t imei_buf[IMEI_LEN + 5]; /* account for /n/r */
static struct lwm2m_ctx client;

#if defined(CONFIG_LWM2M_DTLS_SUPPORT)
#include "config.h"
#endif /* CONFIG_LWM2M_DTLS_SUPPORT */

static struct k_sem lwm2m_restart;

static void rd_client_event(struct lwm2m_ctx *client,
			    enum lwm2m_rd_client_event client_event);

void client_acknowledge(void)
{
	lwm2m_acknowledge(&client);
}

/**@brief User interface event handler. */
static void ui_evt_handler(struct ui_evt *evt)
{
	if (!evt) {
		return;
	}

	LOG_DBG("Event: %d", evt->button);

#if defined(CONFIG_UI_BUTTON)
	if (handle_button_events(evt) == 0) {
		return;
	}
#endif
#if defined(CONFIG_LWM2M_IPSO_ACCELEROMETER) && CONFIG_FLIP_INPUT > 0
	if (handle_accel_events(evt) == 0) {
		return;
	}
#endif
}

static int remove_whitespace(char *buf)
{
	size_t i, j = 0, len;

	len = strlen(buf);
	for (i = 0; i < len; i++) {
		if (buf[i] >= 32 && buf[i] <= 126) {
			if (j != i) {
				buf[j] = buf[i];
			}

			j++;
		}
	}

	if (j < len) {
		buf[j] = '\0';
	}

	return 0;
}

static int query_modem(const char *cmd, char *buf, size_t buf_len)
{
	int ret;
	enum at_cmd_state at_state;

	ret = at_cmd_write(cmd, buf, buf_len, &at_state);
	if (ret) {
		LOG_ERR("at_cmd_write [%s] error:%d, at_state: %d",
			cmd, ret, at_state);
		strncpy(buf, "error", buf_len);
		return ret;
	}

	remove_whitespace(buf);
	return 0;
}

static int lwm2m_setup(void)
{
#if defined(CONFIG_LWM2M_CLIENT_UTILS_DEVICE_OBJ_SUPPORT)
	/* Manufacturer independent */
	lwm2m_init_device();
#endif

	/* Manufacturer dependent */
	/* use IMEI as serial number */
	lwm2m_app_init_device(imei_buf);

#if defined(CONFIG_LWM2M_CLIENT_UTILS_SECURITY_OBJ_SUPPORT)
	lwm2m_init_security(&client, endpoint_name);
#endif
#if defined(CONFIG_LWM2M_CLIENT_UTILS_LOCATION_OBJ_SUPPORT)
	lwm2m_init_location();
#endif
#if defined(CONFIG_LWM2M_CLIENT_UTILS_FIRMWARE_UPDATE_OBJ_SUPPORT)
	if (lwm2m_init_firmware() < 0) {
		goto fail;
	}
#endif
#if defined(CONFIG_LWM2M_CLIENT_UTILS_CONN_MON_OBJ_SUPPORT)
	lwm2m_init_connmon();
#endif
#if defined(CONFIG_LWM2M_IPSO_LIGHT_CONTROL)
	lwm2m_init_light_control();
#endif
#if defined(CONFIG_LWM2M_IPSO_TEMP_SENSOR)
	lwm2m_init_temp();
#endif
#if defined(CONFIG_UI_BUZZER)
	lwm2m_init_buzzer();
#endif
#if defined(CONFIG_UI_BUTTON)
	lwm2m_init_button();
#endif
#if defined(CONFIG_LWM2M_IPSO_ACCELEROMETER)
	lwm2m_init_accel();
#endif
	return 0;

fail:
	return -1;
}

int lwm2m_security_index_to_inst_id(int index);

static int find_server_security_instance(void)
{
	char pathstr[10];
	bool bootstrap;
	int i;
	int instance;
	int ret;

	for (i = 0; i < CONFIG_LWM2M_SECURITY_INSTANCE_COUNT; i++) {
		instance = lwm2m_security_index_to_inst_id(i);
		if (instance < 0) {
			LOG_DBG("Empty instance at index %d", i);
			continue;
		}

		snprintk(pathstr, sizeof(pathstr), "0/%d/1", instance);

		ret = lwm2m_engine_get_bool(pathstr, &bootstrap);
		if (ret < 0) {
			LOG_ERR("Failed to check bootstrap, err %d", ret);
			continue;
		}

		if (!bootstrap) {
			LOG_DBG("Security instance found, %d", instance);
			return instance;
		}
	}

	return -1;
}

static int get_security_mode(int instance)
{
	char pathstr[10];
	uint8_t security_mode;
	int ret;

	snprintk(pathstr, sizeof(pathstr), "0/%d/2", instance);

	ret = lwm2m_engine_get_u8(pathstr, &security_mode);
	if (ret < 0) {
		LOG_ERR("Failed to obtain security mode, err %d", ret);
		return -1;
	}

	return security_mode;
}

#if defined(CONFIG_LWM2M_DTLS_SUPPORT)
static void provision_psk(int instance)
{
	char pathstr[10];
	char psk_hex[64];
	int ret;
	uint8_t *identity;
	uint16_t identity_len;
	uint8_t *psk;
	uint16_t psk_len;
	uint8_t flags;


	/* Obtain identity. */
	snprintk(pathstr, sizeof(pathstr), "0/%d/3", instance);

	ret = lwm2m_engine_get_res_data(pathstr, (void **)&identity,
					&identity_len, &flags);
	if (ret < 0) {
		LOG_ERR("Failed to obtain client identity.");
		return;
	}

	/* Obtain PSK. */
	snprintk(pathstr, sizeof(pathstr), "0/%d/5", instance);

	ret = lwm2m_engine_get_res_data(pathstr, (void **)&psk,
					&psk_len, &flags);
	if (ret < 0) {
		LOG_ERR("Failed to obtain PSK.");
		return;
	}

	/* Convert PSK to a format accepted by the modem. */
	psk_len = bin2hex(psk, psk_len, psk_hex, sizeof(psk_hex));
	if (psk_len == 0) {
		LOG_ERR("PSK is too large to convert.");
		return;
	}

	lwm2m_rd_client_stop(&client, rd_client_event);
	lte_lc_offline();

	ret = modem_key_mgmt_write(client.tls_tag,
				   MODEM_KEY_MGMT_CRED_TYPE_PSK,
				   psk_hex, psk_len);
	if (ret < 0) {
		LOG_ERR("Error setting cred tag %d type %d: Error %d",
			client.tls_tag, MODEM_KEY_MGMT_CRED_TYPE_PSK,
			ret);
		goto exit;
	}

	ret = modem_key_mgmt_write(client.tls_tag,
				   MODEM_KEY_MGMT_CRED_TYPE_IDENTITY,
				   identity, identity_len);
	if (ret < 0) {
		LOG_ERR("Error setting cred tag %d type %d: Error %d",
			client.tls_tag, MODEM_KEY_MGMT_CRED_TYPE_IDENTITY,
			ret);
	}

exit:
	lte_lc_connect();
	lwm2m_rd_client_start(&client, endpoint_name, false, rd_client_event);
}
#endif

static void provision_credentials(void)
{
	int security_instance;
	int security_mode;

	security_instance = find_server_security_instance();
	if (security_instance == -1) {
		LOG_ERR("No security instance found");
		return;
	}

	security_mode = get_security_mode(security_instance);
	if (security_mode == -1) {
		return;
	}

	switch (security_mode) {
#if defined(CONFIG_LWM2M_DTLS_SUPPORT)
	case LWM2M_SECURITY_PRE_SHARED_KEY:
		LOG_DBG("PSK mode, provisioning key and identity.");
		client.tls_tag = SERVER_TLS_TAG;
		provision_psk(security_instance);
		break;
#endif

	case LWM2M_SECURITY_NO_SEC:
		LOG_DBG("NoSec mode, no provisioning needed.");
		break;

	default:
		LOG_ERR("Unsupported security mode");
		break;
	}
}

static void rd_client_event(struct lwm2m_ctx *client,
			    enum lwm2m_rd_client_event client_event)
{
	switch (client_event) {

	case LWM2M_RD_CLIENT_EVENT_NONE:
		/* do nothing */
		break;

	case LWM2M_RD_CLIENT_EVENT_BOOTSTRAP_REG_FAILURE:
		LOG_DBG("Bootstrap registration failure!");
		break;

	case LWM2M_RD_CLIENT_EVENT_BOOTSTRAP_REG_COMPLETE:
		LOG_DBG("Bootstrap registration complete");
		break;

	case LWM2M_RD_CLIENT_EVENT_BOOTSTRAP_TRANSFER_COMPLETE:
		LOG_DBG("Bootstrap transfer complete");
		LOG_DBG("Boostrap finished, provisioning credentials.");
		provision_credentials();
		break;

	case LWM2M_RD_CLIENT_EVENT_REGISTRATION_FAILURE:
		LOG_DBG("Registration failure!");
		break;

	case LWM2M_RD_CLIENT_EVENT_REGISTRATION_COMPLETE:
		LOG_DBG("Registration complete");
		break;

	case LWM2M_RD_CLIENT_EVENT_REG_UPDATE_FAILURE:
		LOG_DBG("Registration update failure!");
		break;

	case LWM2M_RD_CLIENT_EVENT_REG_UPDATE_COMPLETE:
		LOG_DBG("Registration update complete");
		break;

	case LWM2M_RD_CLIENT_EVENT_DEREGISTER_FAILURE:
		LOG_DBG("Deregister failure!");
		break;

	case LWM2M_RD_CLIENT_EVENT_DISCONNECT:
		LOG_DBG("Disconnected");
		break;

	case LWM2M_RD_CLIENT_EVENT_QUEUE_MODE_RX_OFF:
		LOG_DBG("Queue mode RX window closed");
		break;

	case LWM2M_RD_CLIENT_EVENT_NETWORK_ERROR:
		LOG_ERR("LwM2M engine reported a network error.");
		k_sem_give(&lwm2m_restart);
		break;
	}
}

static void modem_connect(void)
{
	int ret;

#if defined(CONFIG_LWM2M_QUEUE_MODE_ENABLED)
	ret = lte_lc_psm_req(true);
	if (ret < 0) {
		LOG_ERR("lte_lc_psm_req, error: (%d)", ret);
	} else {
		LOG_INF("PSM mode requested");
	}
#endif

	do {
		LOG_INF("Connecting to LTE network.");
		LOG_INF("This may take several minutes.");
		ui_led_set_pattern(UI_LTE_CONNECTING);

		ret = lte_lc_connect();
		if (ret < 0) {
			LOG_WRN("Failed to establish LTE connection (%d).",
				ret);
			LOG_WRN("Will retry in a minute.");
			lte_lc_offline();
			k_sleep(K_SECONDS(60));
		} else {
			LOG_INF("Connected to LTE network");
			ui_led_set_pattern(UI_LTE_CONNECTED);
		}
	} while (ret < 0);
}

void main(void)
{
	uint32_t flags = IS_ENABLED(CONFIG_LWM2M_RD_CLIENT_SUPPORT_BOOTSTRAP) ?
				    LWM2M_RD_CLIENT_FLAG_BOOTSTRAP : 0;
	int ret;

	LOG_INF(APP_BANNER);

	k_sem_init(&lwm2m_restart, 0, 1);

	ui_init(ui_evt_handler);

#if defined(CONFIG_LWM2M_CLIENT_UTILS_FIRMWARE_UPDATE_OBJ_SUPPORT)
	ret = fota_settings_init();
	if (ret < 0) {
		LOG_ERR("Unable to init settings (%d)", ret);
		return;
	}
#endif

	/* Load *all* persistent settings */
	settings_load();

#if defined(CONFIG_LWM2M_CLIENT_UTILS_FIRMWARE_UPDATE_OBJ_SUPPORT)
	/* Modem FW update needs to be verified before modem is used. */
	lwm2m_verify_modem_fw_update();
#endif

	LOG_INF("Initializing modem.");
	ret = lte_lc_init();
	if (ret < 0) {
		LOG_ERR("Unable to init modem (%d)", ret);
		return;
	}

	/* query IMEI */
	query_modem("AT+CGSN", imei_buf, sizeof(imei_buf));
	/* use IMEI as unique endpoint name */
	snprintf(endpoint_name, sizeof(endpoint_name), "nrf-%s", imei_buf);
	LOG_INF("endpoint: %s", log_strdup(endpoint_name));

	/* Setup LwM2M */
	(void)memset(&client, 0x0, sizeof(client));

	ret = lwm2m_setup();
	if (ret < 0) {
		LOG_ERR("Cannot setup LWM2M fields (%d)", ret);
		return;
	}

#if defined(CONFIG_LWM2M_CLIENT_UTILS_FIRMWARE_UPDATE_OBJ_SUPPORT)
	ret = lwm2m_init_image();
	if (ret < 0) {
		LOG_ERR("Failed to setup image properties (%d)", ret);
		return;
	}
#endif

#if defined(CONFIG_LWM2M_DTLS_SUPPORT)
	ret = modem_key_mgmt_write(client.tls_tag,
				   MODEM_KEY_MGMT_CRED_TYPE_PSK,
				   client_psk, strlen(client_psk));
	if (ret < 0) {
		LOG_ERR("Error setting cred tag %d type %d: Error %d",
			client.tls_tag, MODEM_KEY_MGMT_CRED_TYPE_PSK,
			ret);
	}

	ret = modem_key_mgmt_write(client.tls_tag,
				   MODEM_KEY_MGMT_CRED_TYPE_IDENTITY,
				   endpoint_name, strlen(endpoint_name));
	if (ret < 0) {
		LOG_ERR("Error setting cred tag %d type %d: Error %d",
			client.tls_tag, MODEM_KEY_MGMT_CRED_TYPE_IDENTITY,
			ret);
	}
#endif

	modem_connect();

	while (true) {
#if defined(CONFIG_LWM2M_CLIENT_UTILS_CONN_MON_OBJ_SUPPORT)
		ret = lwm2m_update_connmon();
		if (ret < 0) {
			LOG_ERR("Error registering rsrp handler (%d)", ret);
		}
#endif

		lwm2m_rd_client_start(&client, endpoint_name, flags,
				      rd_client_event);

		k_sem_take(&lwm2m_restart, K_FOREVER);

		LOG_INF("LwM2M restart requested. The sample will try to"
			" re-establish network connection.");

		/* Stop the LwM2M engine. */
		lwm2m_rd_client_stop(&client, rd_client_event);

		/* Try to reconnect to the network. */
		ret = lte_lc_offline();
		if (ret < 0) {
			LOG_ERR("Failed to put LTE link in offline state. (%d)",
				ret);
		}

		modem_connect();
	}
}
```
