## lib/nrf91_lwm2m_app/Kconfig
```kconfig
#
# Copyright (c) 2021 Nordic Semiconductor
#
# SPDX-License-Identifier: LicenseRef-Nordic-5-Clause
#

config NRF91_LWM2M_APP
	bool "nRF91 LWM2M client application library"
	select LWM2M

if NRF91_LWM2M_APP

config NRF91_LWM2M_APP_DEVICE_OBJ_SUPPORT
	bool "Device object support"
	default y

config NRF91_LWM2M_APP_SECURITY_OBJ_SUPPORT
	bool "Security object support"
	default y

config NRF91_LWM2M_APP_CONN_MON_OBJ_SUPPORT
	bool "Connection Monitor object support"
	default y
	select LWM2M_CONN_MON_OBJ_SUPPORT

if NRF91_LWM2M_APP_CONN_MON_OBJ_SUPPORT

config LWM2M_CONN_MON_BEARER_MAX
	int "Max number of bearers"
	default 2

endif # NRF91_LWM2M_APP_CONN_MON_OBJ_SUPPORT

config NRF91_LWM2M_APP_LOCATION_OBJ_SUPPORT
	bool "Location object support"
	default y
	select LWM2M_CONN_LOCATION_OBJ_SUPPORT

config NRF91_LWM2M_APP_FIRMWARE_UPDATE_OBJ_SUPPORT
	bool "Firmware Update object support"
	default y
	select LWM2M_FIRMWARE_UPDATE_OBJ_SUPPORT
	select DFU_TARGET
	select BOOTLOADER_MCUBOOT
	select IMG_MANAGER
	select IMG_ERASE_PROGRESSIVELY
	select FLASH
	select MPU_ALLOW_FLASH_WRITE

module = NRF91_LWM2M_APP
module-dep = LOG
module-str = nRF91 LWM2M client applicaton library
source "${ZEPHYR_BASE}/subsys/logging/Kconfig.template.log_config"

endif # NRF91_LWM2M_APP
```
